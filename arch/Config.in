## package/Config.in
```kconfig
menu "Default Packages"

	source "package/busybox/Config.in"

menu "Audio and video applications"
	source "package/alsa-utils/Config.in"
	source "package/aumix/Config.in"
	source "package/bellagio/Config.in"
	source "package/faad2/Config.in"
	source "package/ffmpeg/Config.in"
	source "package/flac/Config.in"
	source "package/flite/Config.in"
	source "package/gstreamer/Config.in"
	source "package/gstreamer1/Config.in"
	source "package/jack2/Config.in"
	source "package/lame/Config.in"
	source "package/libvpx/Config.in"
	source "package/madplay/Config.in"
	source "package/mpd/Config.in"
	source "package/mpg123/Config.in"
	source "package/mplayer/Config.in"
	source "package/musepack/Config.in"
	source "package/ncmpc/Config.in"
	source "package/on2-8170-libs/Config.in"
	source "package/opus-tools/Config.in"
	source "package/pulseaudio/Config.in"
	source "package/sox/Config.in"
	source "package/tidsp-binaries/Config.in"
	source "package/tstools/Config.in"
	source "package/twolame/Config.in"
	source "package/upmpdcli/Config.in"
	source "package/vlc/Config.in"
	source "package/vorbis-tools/Config.in"
	source "package/wavpack/Config.in"
	source "package/xbmc/Config.in"
	source "package/yavta/Config.in"
endmenu

menu "Compressors and decompressors"
	source "package/bzip2/Config.in"
if BR2_PACKAGE_BUSYBOX_SHOW_OTHERS
	source "package/gzip/Config.in"
endif
	source "package/infozip/Config.in"
	source "package/lz4/Config.in"
	source "package/lzip/Config.in"
	source "package/lzop/Config.in"
	source "package/xz/Config.in"
endmenu

menu "Debugging, profiling and benchmark"
	source "package/bonnie/Config.in"
	source "package/cache-calibrator/Config.in"
	source "package/dhrystone/Config.in"
	source "package/dmalloc/Config.in"
	source "package/dropwatch/Config.in"
	source "package/dstat/Config.in"
	source "package/duma/Config.in"
	source "package/fio/Config.in"
	source "package/gdb/Config.in"
	source "package/google-breakpad/Config.in"
	source "package/iozone/Config.in"
	source "package/kexec/Config.in"
	source "package/kexec-lite/Config.in"
	source "package/ktap/Config.in"
	source "package/latencytop/Config.in"
	source "package/lmbench/Config.in"
if BR2_PACKAGE_BUSYBOX_SHOW_OTHERS
	source "package/lsof/Config.in"
endif
	source "package/ltp-testsuite/Config.in"
	source "package/ltrace/Config.in"
	source "package/lttng-babeltrace/Config.in"
	source "package/lttng-modules/Config.in"
	source "package/lttng-tools/Config.in"
	source "package/memstat/Config.in"
	source "package/netperf/Config.in"
	source "package/oprofile/Config.in"
	source "package/pax-utils/Config.in"
	source "package/perf/Config.in"
	source "package/pv/Config.in"
	source "package/ramsmp/Config.in"
	source "package/ramspeed/Config.in"
	source "package/rt-tests/Config.in"
	source "package/strace/Config.in"
	source "package/stress/Config.in"
	source "package/sysprof/Config.in"
	source "package/tinymembench/Config.in"
	source "package/trace-cmd/Config.in"
	source "package/valgrind/Config.in"
	source "package/whetstone/Config.in"
endmenu

menu "Development tools"
	source "package/binutils/Config.in"
	source "package/bison/Config.in"
	source "package/bsdiff/Config.in"
	source "package/bustle/Config.in"
	source "package/cvs/Config.in"
if BR2_PACKAGE_BUSYBOX_SHOW_OTHERS
	source "package/diffutils/Config.in"
endif
	source "package/distcc/Config.in"
if BR2_PACKAGE_BUSYBOX_SHOW_OTHERS
	source "package/findutils/Config.in"
endif
	source "package/flex/Config.in"
if BR2_PACKAGE_BUSYBOX_SHOW_OTHERS
	source "package/gawk/Config.in"
endif
	source "package/gettext/Config.in"
	source "package/git/Config.in"
	source "package/gperf/Config.in"
if BR2_PACKAGE_BUSYBOX_SHOW_OTHERS
	source "package/grep/Config.in"
endif
	source "package/intltool/Config.in"
	source "package/jq/Config.in"
	source "package/libtool/Config.in"
	source "package/m4/Config.in"
	source "package/make/Config.in"
if BR2_PACKAGE_BUSYBOX_SHOW_OTHERS
	source "package/patch/Config.in"
endif
	source "package/pkgconf/Config.in"
if BR2_PACKAGE_BUSYBOX_SHOW_OTHERS
	source "package/sed/Config.in"
endif
	source "package/sstrip/Config.in"
	source "package/subversion/Config.in"
if BR2_PACKAGE_BUSYBOX_SHOW_OTHERS
	source "package/tar/Config.in"
endif
	source "package/tree/Config.in"
	source "package/yasm/Config.in"
endmenu

menu "Filesystem and flash utilities"
	source "package/btrfs-progs/Config.in"
	source "package/cifs-utils/Config.in"
	source "package/cramfs/Config.in"
	source "package/curlftpfs/Config.in"
	source "package/dosfstools/Config.in"
	source "package/e2fsprogs/Config.in"
	source "package/e2tools/Config.in"
	source "package/ecryptfs-utils/Config.in"
	source "package/exfat/Config.in"
	source "package/exfat-utils/Config.in"
	source "package/f2fs-tools/Config.in"
	source "package/flashbench/Config.in"
	source "package/genext2fs/Config.in"
	source "package/genromfs/Config.in"
	source "package/kobs-ng/Config.in"
	source "package/makedevs/Config.in"
	source "package/mmc-utils/Config.in"
	source "package/mtd/Config.in"
	source "package/mtools/Config.in"
	source "package/nfs-utils/Config.in"
	source "package/ntfs-3g/Config.in"
	source "package/simicsfs/Config.in"
	source "package/squashfs/Config.in"
	source "package/sshfs/Config.in"
	source "package/sunxi-tools/Config.in"
	source "package/unionfs/Config.in"
	source "package/xfsprogs/Config.in"
endmenu

menu "Graphic libraries and applications (graphic/text)"

comment "Graphic libraries"
	source "package/cegui06/Config.in"
	source "package/directfb/Config.in"
	source "package/directfb-examples/Config.in"
	source "package/divine/Config.in"
	source "package/fbdump/Config.in"
	source "package/fbgrab/Config.in"
if BR2_PACKAGE_BUSYBOX_SHOW_OTHERS
	source "package/fbset/Config.in"
endif
	source "package/fb-test-app/Config.in"
	source "package/fbterm/Config.in"
	source "package/fbv/Config.in"
	source "package/imagemagick/Config.in"
	source "package/linux-fusion/Config.in"
	source "package/lite/Config.in"
	source "package/mesa3d/Config.in"
	source "package/ocrad/Config.in"
	source "package/psplash/Config.in"
	source "package/sawman/Config.in"
	source "package/sdl/Config.in"
	source "package/sdl_gfx/Config.in"
	source "package/sdl_image/Config.in"
	source "package/sdl_mixer/Config.in"
	source "package/sdl_net/Config.in"
	source "package/sdl_sound/Config.in"
	source "package/sdl_ttf/Config.in"
endmenu

menu "Interpreter languages and scripting"
	source "package/enscript/Config.in"
	source "package/erlang/Config.in"
	source "package/haserl/Config.in"
	source "package/jamvm/Config.in"
	source "package/jimtcl/Config.in"
	source "package/lua/Config.in"
	source "package/luainterpreter/Config.in"
	source "package/luajit/Config.in"
if BR2_PACKAGE_HAS_LUAINTERPRETER && !BR2_PREFER_STATIC_LIB
# lua modules are dynamically loaded, so not available on static builds
menu "Lua libraries/modules"
	source "package/cgilua/Config.in"
	source "package/copas/Config.in"
	source "package/cosmo/Config.in"
	source "package/coxpcall/Config.in"
	source "package/dado/Config.in"
	source "package/lbase64/Config.in"
	source "package/ljlinenoise/Config.in"
	source "package/ljsyscall/Config.in"
	source "package/lpeg/Config.in"
	source "package/lpty/Config.in"
	source "package/lrandom/Config.in"
	source "package/lsqlite3/Config.in"
	source "package/lua-cjson/Config.in"
	source "package/lua-coat/Config.in"
	source "package/lua-coatpersistent/Config.in"
	source "package/lua-csnappy/Config.in"
	source "package/lua-ev/Config.in"
	source "package/lua-messagepack/Config.in"
	source "package/lua-msgpack-native/Config.in"
	source "package/lua-testmore/Config.in"
	source "package/luasql-sqlite3/Config.in"
	source "package/luabitop/Config.in"
	source "package/luacrypto/Config.in"
	source "package/luaexpat/Config.in"
	source "package/luaexpatutils/Config.in"
	source "package/luafilesystem/Config.in"
	source "package/luajson/Config.in"
	source "package/lualogging/Config.in"
	source "package/luaposix/Config.in"
	source "package/luasec/Config.in"
	source "package/luasocket/Config.in"
	source "package/lunit/Config.in"
	source "package/lzlib/Config.in"
	source "package/orbit/Config.in"
	source "package/rings/Config.in"
	source "package/wsapi/Config.in"
	source "package/xavante/Config.in"
endmenu
endif
	source "package/nodejs/Config.in"
	source "package/perl/Config.in"
if BR2_PACKAGE_PERL
menu "Perl libraries/modules"
	source "package/perl-datetime-tiny/Config.in"
	source "package/perl-gd/Config.in"
	source "package/perl-gdgraph/Config.in"
	source "package/perl-gdtextutil/Config.in"
	source "package/perl-io-socket-ssl/Config.in"
	source "package/perl-json-tiny/Config.in"
	source "package/perl-mojolicious/Config.in"
	source "package/perl-net-ssleay/Config.in"
	source "package/perl-path-tiny/Config.in"
	source "package/perl-try-tiny/Config.in"
	source "package/perl-xml-libxml/Config.in"
	source "package/perl-xml-namespacesupport/Config.in"
	source "package/perl-xml-sax-base/Config.in"
	source "package/perl-xml-sax/Config.in"
endmenu
endif
	source "package/php/Config.in"
if BR2_PACKAGE_PHP
if !BR2_PREFER_STATIC_LIB
menu "External php extensions"
	source "package/php-geoip/Config.in"
	source "package/php-gnupg/Config.in"
	source "package/php-imagick/Config.in"
	source "package/php-memcached/Config.in"
	source "package/php-ssh2/Config.in"
	source "package/php-yaml/Config.in"
	source "package/php-zmq/Config.in"
endmenu
endif
if BR2_PREFER_STATIC_LIB
comment "External PHP extensions need a toolchain w/ dynamic library"
endif
endif
	source "package/python/Config.in"
	source "package/python3/Config.in"
if BR2_PACKAGE_PYTHON || BR2_PACKAGE_PYTHON3
menu "external python modules"
	source "package/python-bottle/Config.in"
	source "package/python-configobj/Config.in"
	source "package/python-crc16/Config.in"
	source "package/python-dialog/Config.in"
	source "package/python-dpkt/Config.in"
	source "package/python-id3/Config.in"
	source "package/python-ipy/Config.in"
	source "package/python-json-schema-validator/Config.in"
	source "package/python-keyring/Config.in"
	source "package/python-libconfig/Config.in"
	source "package/python-mad/Config.in"
	source "package/python-meld3/Config.in"
	source "package/python-msgpack/Config.in"
	source "package/python-netifaces/Config.in"
	source "package/python-nfc/Config.in"
	source "package/python-numpy/Config.in"
	source "package/python-posix-ipc/Config.in"
	source "package/python-protobuf/Config.in"
	source "package/python-pyasn/Config.in"
	source "package/python-pycrypto/Config.in"
	source "package/python-pygame/Config.in"
	source "package/python-pyparsing/Config.in"
	source "package/python-pypcap/Config.in"
	source "package/python-pyro/Config.in"
	source "package/python-pysnmp/Config.in"
	source "package/python-pysnmp-apps/Config.in"
	source "package/python-pysnmp-mibs/Config.in"
	source "package/python-pyusb/Config.in"
	source "package/python-pyzmq/Config.in"
	source "package/python-serial/Config.in"
	source "package/python-setuptools/Config.in"
	source "package/python-simplejson/Config.in"
	source "package/python-thrift/Config.in"
	source "package/python-tornado/Config.in"
	source "package/python-versiontools/Config.in"
endmenu
endif
	source "package/ruby/Config.in"
	source "package/tcl/Config.in"
if BR2_PACKAGE_TCL
menu "tcl libraries/modules"
	source "package/expect/Config.in"
	source "package/tcllib/Config.in"
endmenu
endif
endmenu

menu "Libraries"

menu "Compression and decompression"
	source "package/libarchive/Config.in"
	source "package/lzo/Config.in"
	source "package/snappy/Config.in"
	source "package/zlib/Config.in"
endmenu

menu "Crypto"
	source "package/beecrypt/Config.in"
	source "package/ca-certificates/Config.in"
	source "package/cryptodev/Config.in"
	source "package/gnutls/Config.in"
	source "package/libassuan/Config.in"
	source "package/libgcrypt/Config.in"
	source "package/libgpg-error/Config.in"
	source "package/libgpgme/Config.in"
	source "package/libksba/Config.in"
	source "package/libmcrypt/Config.in"
	source "package/libmhash/Config.in"
	source "package/libnss/Config.in"
	source "package/libsecret/Config.in"
	source "package/libsha1/Config.in"
	source "package/libssh2/Config.in"
	source "package/nettle/Config.in"
	source "package/openssl/Config.in"
	source "package/polarssl/Config.in"
endmenu

menu "Database"
	source "package/berkeleydb/Config.in"
	source "package/mysql/Config.in"
	source "package/sqlite/Config.in"
endmenu

menu "Filesystem"
	source "package/libconfig/Config.in"
	source "package/libconfuse/Config.in"
	source "package/libfuse/Config.in"
endmenu

menu "Graphics"
	source "package/cairo/Config.in"
	source "package/fltk/Config.in"
	source "package/fontconfig/Config.in"
	source "package/freetype/Config.in"
	source "package/gd/Config.in"
	source "package/harfbuzz/Config.in"
	source "package/jpeg/Config.in"
	source "package/lcms2/Config.in"
	source "package/lesstif/Config.in"
	source "package/libexif/Config.in"
	source "package/libgail/Config.in"
	source "package/libgeotiff/Config.in"
	source "package/libpng/Config.in"
	source "package/libqrencode/Config.in"
	source "package/libraw/Config.in"
	source "package/librsvg/Config.in"
	source "package/libsvg/Config.in"
	source "package/libsvg-cairo/Config.in"
	source "package/libsvgtiny/Config.in"
	source "package/libungif/Config.in"
	source "package/pango/Config.in"
	source "package/pixman/Config.in"
	source "package/poppler/Config.in"
	source "package/tiff/Config.in"
endmenu

menu "JSON/XML"
	source "package/cjson/Config.in"
	source "package/expat/Config.in"
	source "package/json-c/Config.in"
	source "package/json-glib/Config.in"
	source "package/libjson/Config.in"
	source "package/libxml2/Config.in"
	source "package/libyaml/Config.in"
endmenu

menu "Networking"
	source "package/libcurl/Config.in"
	source "package/libpcap/Config.in"
	source "package/librsync/Config.in"
	source "package/libsocketcan/Config.in"
	source "package/libshairplay/Config.in"
	source "package/libsoup/Config.in"
	source "package/libstrophe/Config.in"
	source "package/libtorrent/Config.in"
	source "package/libvncserver/Config.in"
	source "package/neon/Config.in"
endmenu

menu "Other"
	source "package/apr/Config.in"
	source "package/apr-util/Config.in"
	source "package/argp-standalone/Config.in"
	source "package/armadillo/Config.in"
	source "package/boost/Config.in"
	source "package/clapack/Config.in"
	source "package/classpath/Config.in"
	source "package/cppcms/Config.in"
	source "package/eigen/Config.in"
	source "package/elfutils/Config.in"
	source "package/fftw/Config.in"
	source "package/flann/Config.in"
	source "package/glibmm/Config.in"
	source "package/gmp/Config.in"
	source "package/gsl/Config.in"
	source "package/gtest/Config.in"
	source "package/libargtable2/Config.in"
	source "package/libatomic_ops/Config.in"
	source "package/libbsd/Config.in"
	source "package/libcap/Config.in"
	source "package/libcap-ng/Config.in"
	source "package/libcgroup/Config.in"
	source "package/libcofi/Config.in"
	source "package/libdaemon/Config.in"
	source "package/libee/Config.in"
	source "package/libelf/Config.in"
	source "package/libev/Config.in"
	source "package/libevdev/Config.in"
	source "package/libevent/Config.in"
	source "package/libffi/Config.in"
	source "package/libgc/Config.in"
	source "package/libglib2/Config.in"
	source "package/libical/Config.in"
	source "package/libnspr/Config.in"
	source "package/libpfm4/Config.in"
	source "package/libplist/Config.in"
	source "package/libpthread-stubs/Config.in"
	source "package/libpthsem/Config.in"
	source "package/libseccomp/Config.in"
	source "package/libsigc/Config.in"
	source "package/libsigsegv/Config.in"
	source "package/libtasn1/Config.in"
	source "package/libtpl/Config.in"
	source "package/libubox/Config.in"
	source "package/libuci/Config.in"
	source "package/libunwind/Config.in"
	source "package/liburcu/Config.in"
	source "package/libuv/Config.in"
	source "package/linux-pam/Config.in"
	source "package/lttng-libust/Config.in"
	source "package/mpc/Config.in"
	source "package/mpfr/Config.in"
	source "package/msgpack/Config.in"
	source "package/mtdev2tuio/Config.in"
	source "package/orc/Config.in"
	source "package/p11-kit/Config.in"
	source "package/poco/Config.in"
	source "package/protobuf/Config.in"
	source "package/protobuf-c/Config.in"
	source "package/qhull/Config.in"
	source "package/schifra/Config.in"
	source "package/startup-notification/Config.in"
	source "package/tz/Config.in"
	source "package/tzdata/Config.in"
endmenu

menu "Security"
	source "package/libsepol/Config.in"
endmenu

menu "Text and terminal handling"
	source "package/enchant/Config.in"
	source "package/icu/Config.in"
	source "package/libedit/Config.in"
	source "package/libenca/Config.in"
	source "package/libestr/Config.in"
	source "package/libfribidi/Config.in"
	source "package/libiconv/Config.in"
	source "package/linenoise/Config.in"
	source "package/ncurses/Config.in"
	source "package/newt/Config.in"
	source "package/pcre/Config.in"
	source "package/popt/Config.in"
	source "package/readline/Config.in"
	source "package/slang/Config.in"
	source "package/tclap/Config.in"
endmenu

endmenu

menu "Miscellaneous"
	source "package/bc/Config.in"
	source "package/collectd/Config.in"
	source "package/empty/Config.in"
	source "package/googlefontdirectory/Config.in"
	source "package/mcrypt/Config.in"
endmenu

menu "Mail"
	source "package/exim/Config.in"
	source "package/fetchmail/Config.in"
	source "package/heirloom-mailx/Config.in"
	source "package/libesmtp/Config.in"
	source "package/msmtp/Config.in"
	source "package/mutt/Config.in"
	source "package/sylpheed/Config.in"
endmenu

menu "Networking applications"
	source "package/aiccu/Config.in"
	source "package/aircrack-ng/Config.in"
	source "package/argus/Config.in"
	source "package/arptables/Config.in"
	source "package/atftp/Config.in"
	source "package/autossh/Config.in"
	source "package/avahi/Config.in"
	source "package/axel/Config.in"
	source "package/bcusdk/Config.in"
	source "package/bind/Config.in"
	source "package/bluez_utils/Config.in"
	source "package/bmon/Config.in"
	source "package/boa/Config.in"
	source "package/bridge-utils/Config.in"
	source "package/bwm-ng/Config.in"
	source "package/can-utils/Config.in"
	source "package/chrony/Config.in"
	source "package/civetweb/Config.in"
	source "package/connman/Config.in"
	source "package/conntrack-tools/Config.in"
	source "package/crda/Config.in"
	source "package/ctorrent/Config.in"
	source "package/cups/Config.in"
if BR2_PACKAGE_BUSYBOX_SHOW_OTHERS
	source "package/dhcp/Config.in"
endif
	source "package/dhcpcd/Config.in"
	source "package/dhcpdump/Config.in"
	source "package/dnsmasq/Config.in"
	source "package/dropbear/Config.in"
	source "package/ebtables/Config.in"
	source "package/ethtool/Config.in"
	source "package/faifa/Config.in"
	source "package/fmc/Config.in"
	source "package/foomatic-filters/Config.in"
	source "package/fping/Config.in"
	source "package/gesftpserver/Config.in"
	source "package/gutenprint/Config.in"
	source "package/hiawatha/Config.in"
	source "package/hostapd/Config.in"
	source "package/hplip/Config.in"
	source "package/httping/Config.in"
if BR2_PACKAGE_BUSYBOX_SHOW_OTHERS
	source "package/ifplugd/Config.in"
endif
	source "package/iftop/Config.in"
	source "package/igh-ethercat/Config.in"
	source "package/igmpproxy/Config.in"
	source "package/inadyn/Config.in"
	source "package/iperf/Config.in"
	source "package/iproute2/Config.in"
	source "package/ipsec-tools/Config.in"
	source "package/ipset/Config.in"
	source "package/iptables/Config.in"
	source "package/iptraf-ng/Config.in"
	source "package/iputils/Config.in"
	source "package/iw/Config.in"
	source "package/kismet/Config.in"
	source "package/knock/Config.in"
	source "package/lftp/Config.in"
	source "package/lighttpd/Config.in"
	source "package/linknx/Config.in"
	source "package/links/Config.in"
	source "package/linphone/Config.in"
	source "package/linux-zigbee/Config.in"
	source "package/lrzsz/Config.in"
	source "package/macchanger/Config.in"
	source "package/memcached/Config.in"
	source "package/mii-diag/Config.in"
	source "package/minidlna/Config.in"
	source "package/mongoose/Config.in"
	source "package/mongrel2/Config.in"
	source "package/mrouted/Config.in"
	source "package/mtr/Config.in"
	source "package/nbd/Config.in"
	source "package/ncftp/Config.in"
	source "package/ndisc6/Config.in"
	source "package/netatalk/Config.in"
if BR2_PACKAGE_BUSYBOX_SHOW_OTHERS
	source "package/netcat/Config.in"
endif
	source "package/netplug/Config.in"
	source "package/netsnmp/Config.in"
	source "package/netstat-nat/Config.in"
if BR2_PACKAGE_BUSYBOX_SHOW_OTHERS
	source "package/net-tools/Config.in"
endif
	source "package/network-manager/Config.in"
	source "package/nfacct/Config.in"
	source "package/nftables/Config.in"
	source "package/ngircd/Config.in"
	source "package/ngrep/Config.in"
	source "package/nmap/Config.in"
	source "package/noip/Config.in"
	source "package/ntp/Config.in"
	source "package/nuttcp/Config.in"
	source "package/olsr/Config.in"
	source "package/openntpd/Config.in"
	source "package/openobex/Config.in"
	source "package/openssh/Config.in"
	source "package/openswan/Config.in"
	source "package/openvpn/Config.in"
	source "package/p910nd/Config.in"
	source "package/portmap/Config.in"
	source "package/pppd/Config.in"
	source "package/pptp-linux/Config.in"
	source "package/proftpd/Config.in"
	source "package/proxychains-ng/Config.in"
	source "package/ptpd/Config.in"
	source "package/ptpd2/Config.in"
	source "package/quagga/Config.in"
	source "package/radvd/Config.in"
	source "package/rp-pppoe/Config.in"
	source "package/rpcbind/Config.in"
	source "package/rsh-redone/Config.in"
	source "package/rsync/Config.in"
	source "package/rtorrent/Config.in"
	source "package/rtptools/Config.in"
	source "package/samba/Config.in"
	source "package/samba4/Config.in"
	source "package/sconeserver/Config.in"
	source "package/ser2net/Config.in"
	source "package/smcroute/Config.in"
	source "package/socat/Config.in"
	source "package/socketcand/Config.in"
	source "package/spawn-fcgi/Config.in"
	source "package/spice/Config.in"
	source "package/spice-protocol/Config.in"
	source "package/squid/Config.in"
	source "package/sshpass/Config.in"
	source "package/strongswan/Config.in"
	source "package/stunnel/Config.in"
	source "package/tcpdump/Config.in"
	source "package/tcping/Config.in"
	source "package/tcpreplay/Config.in"
if BR2_PACKAGE_BUSYBOX_SHOW_OTHERS
	source "package/tftpd/Config.in"
endif
	source "package/thttpd/Config.in"
	source "package/tinyhttpd/Config.in"
	source "package/tn5250/Config.in"
	source "package/transmission/Config.in"
	source "package/tvheadend/Config.in"
	source "package/udpcast/Config.in"
	source "package/ulogd/Config.in"
	source "package/ushare/Config.in"
	source "package/ussp-push/Config.in"
	source "package/vde2/Config.in"
	source "package/vpnc/Config.in"
	source "package/vsftpd/Config.in"
	source "package/vtun/Config.in"
if BR2_PACKAGE_BUSYBOX_SHOW_OTHERS
	source "package/wget/Config.in"
	source "package/whois/Config.in"
endif
	source "package/wireless-regdb/Config.in"
	source "package/wireless_tools/Config.in"
	source "package/wireshark/Config.in"
	source "package/wpa_supplicant/Config.in"
	source "package/wvdial/Config.in"
	source "package/xinetd/Config.in"
	source "package/xl2tp/Config.in"
	source "package/znc/Config.in"

endmenu

menu "Package managers"
	source "package/ipkg/Config.in"
	source "package/opkg/Config.in"
if BR2_PACKAGE_BUSYBOX_SHOW_OTHERS
	source "package/rpm/Config.in"
endif
endmenu

menu "Shell and utilities"
comment "Shells"
if BR2_PACKAGE_BUSYBOX_SHOW_OTHERS
	source "package/bash/Config.in"
	source "package/dash/Config.in"
	source "package/zsh/Config.in"
endif
comment "Utilities"
	source "package/at/Config.in"
	source "package/ccrypt/Config.in"
	source "package/dialog/Config.in"
	source "package/dtach/Config.in"
	source "package/file/Config.in"
	source "package/gnupg/Config.in"
	source "package/gnupg2/Config.in"
	source "package/inotify-tools/Config.in"
	source "package/lockfile-progs/Config.in"
	source "package/logrotate/Config.in"
	source "package/logsurfer/Config.in"
	source "package/pinentry/Config.in"
	source "package/screen/Config.in"
	source "package/sudo/Config.in"
if BR2_PACKAGE_BUSYBOX_SHOW_OTHERS
	source "package/time/Config.in"
endif
	source "package/tmux/Config.in"
if BR2_PACKAGE_BUSYBOX_SHOW_OTHERS
	source "package/which/Config.in"
endif
	source "package/xmlstarlet/Config.in"
endmenu

menu "System tools"
	source "package/acl/Config.in"
	source "package/attr/Config.in"
if BR2_PACKAGE_BUSYBOX_SHOW_OTHERS
	source "package/bootutils/Config.in"
	source "package/coreutils/Config.in"
endif
	source "package/cpuload/Config.in"
if BR2_PACKAGE_BUSYBOX_SHOW_OTHERS
	source "package/dcron/Config.in"
endif
	source "package/dsp-tools/Config.in"
	source "package/ftop/Config.in"
	source "package/htop/Config.in"
	source "package/iprutils/Config.in"
	source "package/keyutils/Config.in"
	source "package/kmod/Config.in"
	source "package/lxc/Config.in"
	source "package/monit/Config.in"
	source "package/ncdu/Config.in"
	source "package/numactl/Config.in"
	source "package/nut/Config.in"
	source "package/powerpc-utils/Config.in"
	source "package/polkit/Config.in"
if BR2_PACKAGE_BUSYBOX_SHOW_OTHERS
	source "package/procps-ng/Config.in"
	source "package/psmisc/Config.in"
endif
	source "package/pwgen/Config.in"
	source "package/quota/Config.in"
if BR2_PACKAGE_BUSYBOX_SHOW_OTHERS
	source "package/rsyslog/Config.in"
endif
	source "package/smack/Config.in"
	source "package/supervisor/Config.in"
if BR2_PACKAGE_BUSYBOX_SHOW_OTHERS
	source "package/sysklogd/Config.in"
endif
	source "package/systemd/Config.in"
if BR2_PACKAGE_BUSYBOX_SHOW_OTHERS
	source "package/sysvinit/Config.in"
endif
	source "package/util-linux/Config.in"
endmenu

menu "Text editors and viewers"
	source "package/ed/Config.in"
	source "package/joe/Config.in"
if BR2_PACKAGE_BUSYBOX_SHOW_OTHERS
	source "package/less/Config.in"
endif
	source "package/nano/Config.in"
	source "package/uemacs/Config.in"
if BR2_PACKAGE_BUSYBOX_SHOW_OTHERS
	source "package/vim/Config.in"
endif
endmenu

endmenu
```
